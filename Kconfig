## Kconfig
```kconfig
# Custom 160x128 colour status screen for the corne_dongle (ST7735).
# Enabled from config/boards/shields/corne_dongle/corne_dongle.conf.

config CORNE_DONGLE_SCREEN
    bool "corne_dongle 160x128 colour status screen"
    depends on ZMK_DISPLAY && ZMK_DISPLAY_STATUS_SCREEN_CUSTOM
    depends on ZMK_SPLIT_ROLE_CENTRAL && ZMK_SPLIT_BLE_CENTRAL_BATTERY_LEVEL_FETCHING
    select LV_USE_LABEL
    select LV_FONT_MONTSERRAT_12
    select LV_FONT_MONTSERRAT_14
    select LV_FONT_MONTSERRAT_20
```

## config/boards/shields/corne_dongle/Kconfig.defconfig
```kconfig
# Copyright (c) 2024 The ZMK Contributors
# SPDX-License-Identifier: MIT

if SHIELD_CORNE_DONGLE

config ZMK_KEYBOARD_NAME
    default "Eyelash Dongle"

config ZMK_SPLIT
    default y

config ZMK_SPLIT_ROLE_CENTRAL
    default y

endif # SHIELD_CORNE_DONGLE
```

## dts/bindings/behaviors/zmk,behavior-screen-rotate.yaml
```yaml
# Copyright (c) 2024 The ZMK Contributors
# SPDX-License-Identifier: MIT

description: Rotate the corne_dongle screen by 180 degrees (toggle)

compatible: "zmk,behavior-screen-rotate"

include: zero_param.yaml
```
